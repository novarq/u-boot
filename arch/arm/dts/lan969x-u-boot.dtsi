
&switch {
	/delete-property/ reg;
	/delete-property/ reg-names;

	reg = <0xe2900000 0x100000>, // ANA_AC
	      <0xe2400000 0x100000>, // ANA_CL
	      <0xe2800000 0x100000>, // ANA_L2
	      <0xe2480000 0x100000>, // ANA_L3
	      <0xe3200000 0x10000>,  // ASM
	      <0xe2060000 0x10000>,  // LRN
	      <0xe20b0000 0x10000>,  // QFWD
	      <0xe2030000 0x20000>,  // DEVCPU_QS
	      <0xe20a0000 0x10000>,  // QSYS
	      <0xe2600000 0x80000>,  // REW
	      <0xe2a00000 0x80000>,  // VOP
	      <0xe30ec000 0x80000>,  // DSM
	      <0xe22c0000 0x80000>,  // EACL
	      <0xe2080000 0x80000>,  // VCAP_SUPER
	      <0xe2580000 0x80000>,  // HSCH
	      <0xe30f0000 0x10000>,  // PORT_CONF
	      <0xe20c0000 0x10000>,  // XQS
	      <0xe3408000 0x10000>,  // HSIO
	      <0xe2010000 0x10000>,  // GCB
	      <0xe00c0000 0x10000>,  // CPU
	      <0xe2040000 0x10000>,  // PTP
	      <0xe3004000 0x4000>,   // DEV2G5_0
	      <0xe3010000 0x4000>,   // DEV2G5_1
	      <0xe3014000 0x4000>,   // DEV2G5_2
	      <0xe3018000 0x4000>,   // DEV2G5_3
	      <0xe301c000 0x4000>,   // DEV2G5_4
	      <0xe3028000 0x4000>,   // DEV2G5_5
	      <0xe302c000 0x4000>,   // DEV2G5_6
	      <0xe3030000 0x4000>,   // DEV2G5_7
	      <0xe3034000 0x4000>,   // DEV2G5_8
	      <0xe3040000 0x4000>,   // DEV2G5_9
	      <0xe304c000 0x4000>,   // DEV2G5_10
	      <0xe3050000 0x4000>,   // DEV2G5_11
	      <0xe3054000 0x4000>,   // DEV2G5_12
	      <0xe3060000 0x4000>,   // DEV2G5_13
	      <0xe306c000 0x4000>,   // DEV2G5_14
	      <0xe3070000 0x4000>,   // DEV2G5_15
	      <0xe3074000 0x4000>,   // DEV2G5_16
	      <0xe3080000 0x4000>,   // DEV2G5_17
	      <0xe308c000 0x4000>,   // DEV2G5_18
	      <0xe3090000 0x4000>,   // DEV2G5_19
	      <0xe3094000 0x4000>,   // DEV2G5_20
	      <0xe30a0000 0x4000>,   // DEV2G5_21
	      <0xe30ac000 0x4000>,   // DEV2G5_22
	      <0xe30b0000 0x4000>,   // DEV2G5_23
	      <0xe30b4000 0x4000>,   // DEV2G5_24
	      <0xe30c0000 0x4000>,   // DEV2G5_25
	      <0xe30cc000 0x4000>,   // DEV2G5_26
	      <0xe30d8000 0x4000>,   // DEV2G5_27
	      <0xe30e4000 0x4000>,   // DEV2G5_28 (RGMII)
	      <0xe30e8000 0x4000>,   // DEV2G5_29 (RGMII)
	      <0xe3410000 0x150000>; // SERDES
	reg-names =
	      "ana_ac", "ana_cl", "ana_l2", "ana_l3",
	      "asm", "lrn", "qfwd", "qs",
	      "qsys", "rew", "vop", "dsm",
	      "eacl", "vcap_super", "hsch", "port_conf", "xqs",
	      "hsio", "gcb", "cpu", "ptp",
	      "port0", "port1", "port2", "port3",
	      "port4", "port5", "port6", "port7", "port8",
	      "port9", "port10", "port11", "port12", "port13",
	      "port14", "port15", "port16", "port17", "port18",
	      "port19", "port20", "port21", "port22", "port23",
	      "port24", "port25", "port26", "port27", "port28",
	      "port29";
	clocks = <&fabric_clk>;
};
