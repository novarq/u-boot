/*
 * Clock definitions for lan969x asic
 */

/ {
	fabric_clk: fabric_clk {
		compatible = "fixed-clock";
		#clock-cells = <0>;
		clock-frequency = <20000000>;
	};

	clks: fixed_clks {
		compatible = "fixed-clock";
		#clock-cells = <1>;
		clock-frequency = <24000000>;  // FPGA clocks fixed @ 24MHz
	};
};
