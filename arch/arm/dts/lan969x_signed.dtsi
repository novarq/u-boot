/ {
	signature {
		key-dev {
			required = "conf";
			key-name-hint = "dev";
			algo = "sha1,rsa2048";
			rsa,exponent = <0x00 0x10001>;
			rsa,modulus = <0xcfbfd0fa 0x1dd472f3 0xaa6bfa57 0xa5e8fba8 0x617a0f2a 0x4554cde 0x3569ba8b 0xbb948b19 0x39ad4777 0x80c42017 0xe0568d97 0x2a80a1fc 0x299dab32 0x3c1e78f2 0x837a24ce 0x3f0b7394 0x8739f31d 0xcaba9ead 0x49917502 0x9443ddfb 0x97d8de50 0xf9c1a873 0x24b8312f 0x5d0d97ba 0x9d92b21f 0x44120622 0x228dfc54 0x3bef2d6f 0x1fb391c6 0x782e1b93 0x7677a18b 0x2678af0f 0x138df5bd 0x64b80087 0x6ea046e7 0xc9922bd2 0xb928c077 0xcda29d2e 0xa5713525 0x759465b5 0x852577bd 0xc40a9233 0x516f9f6e 0x45653ed1 0x1f62bd9 0x478b7ac9 0xddff297c 0x438501e3 0xbd3e4a02 0x4f851b57 0x81842570 0x507ce1ce 0x3af6ff00 0xc0519a5b 0x655ab6ae 0x4a073221 0xfc719ac8 0xf2360513 0x60c57a5c 0x2c9578f7 0x5b9ca51a 0xf46b67a8 0x21dbfdf4 0x46f0c511>;
			rsa,n0-inverse = <0xe0d340f>;
			rsa,num-bits = <0x800>;
			rsa,r-squared = <0x8c7b3c00 0x2808e8b6 0x25b3e495 0x88cb17a0 0x8dc80f3b 0x2931470f 0x6186d1c5 0xf300592e 0x9e1706ae 0xf18bcfb7 0x3c1f223a 0xe3a8aca3 0xdd5d14d6 0x4dd59f67 0xbce4fb1 0x3bebe47 0xdc716260 0x3b5bc3ec 0x4891b7c7 0x88cb6aad 0xc5ad6144 0x8253b5be 0x26ea6578 0x7bcabc6e 0xa9c391c9 0x360be02e 0x64574b32 0x7445fa80 0x433ee11a 0xf5cd7ec7 0x6472c089 0xa6d0769c 0xde0987a5 0xc32a3b1f 0xaece0ae3 0x4951ede8 0x9df3b025 0x7326a93d 0x4c0e31c1 0x7c57d24a 0x47fa4053 0xf10ba5e4 0xd0655b 0xa6c5a3ae 0x2c653e10 0xae6590a6 0xf6d5f56 0xfab661d9 0xfa253682 0x3baa5bd1 0x1d1e53f2 0xd40efada 0x789c912c 0x52a5adba 0x4c1cb1cc 0x4ad22c1a 0x935893f0 0xadbcad80 0x112d184f 0x90eda7af 0xf9a7c5e7 0x3d2f192b 0x9039c371 0x16dce8ff>;
		};
	};
};
