// SPDX-License-Identifier: (GPL-2.0+ OR MIT)
/*
 * Copyright (c) 2018 Microsemi Corporation
 */

/dts-v1/;
#include "mscc,sparx5_pcb134.dtsi"
#include "mscc,sparx5_nand.dtsi"

/ {
	model = "Sparx5 PCB134/NAND Reference Board";
	compatible = "mscc,sparx5-pcb134", "mscc,sparx5";
};
