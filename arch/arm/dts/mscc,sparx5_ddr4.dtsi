// SPDX-License-Identifier: (GPL-2.0+ OR MIT)
/*
 * Copyright (C) 2022 Microchip Technology Inc. and its subsidiaries.
 *
 */

&ddr {
	microchip,mem-name = "pcb134_ddr4 2023-07-31-09:38:58 48aea415a3b0";
	microchip,mem-speed = <2000>;
	microchip,mem-size = <0x80000000>;
	microchip,mem-bus-width = <32>;

	microchip,main-reg = <
		0x00001091	/* crcparctl1 */
		0x00000001	/* dbictl */
		0x00000000	/* dfimisc */
		0x03908210	/* dfitmg0 */
		0x00040201	/* dfitmg1 */
		0x40400003	/* dfiupd0 */
		0x004000ff	/* dfiupd1 */
		0x00000004	/* ecccfg0 */
		0x000201e8	/* init0 */
		0x00c20000	/* init1 */
		0x0a340101	/* init3 */
		0x10200200	/* init4 */
		0x00110004	/* init5 */
		0x00000401	/* init6 */
		0x00000819	/* init7 */
		0x41040010	/* mstr */
		0x00000000	/* pccfg */
		0x00000000	/* pwrctl */
		0x00210020	/* rfshctl0 */
		0x00000000	/* rfshctl3 */
		0x0000ff10	/* sbrctl */
	>;

	microchip,timing-reg = <
		0x160b1110	/* dramtmg0 */
		0x00050418	/* dramtmg1 */
		0x00000010	/* dramtmg12 */
		0x090a0412	/* dramtmg2 */
		0x0050400c	/* dramtmg3 */
		0x08030308	/* dramtmg4 */
		0x05050303	/* dramtmg5 */
		0x03020c05	/* dramtmg8 */
		0x0003020d	/* dramtmg9 */
		0x07000608	/* odtcfg */
		0x00620082	/* rfshtmg */
	>;

	microchip,mapping-reg = <
		0x0000001f	/* addrmap0 */
		0x003f1717	/* addrmap1 */
		0x00000000	/* addrmap2 */
		0x00000000	/* addrmap3 */
		0x00001f1f	/* addrmap4 */
		0x04040404	/* addrmap5 */
		0x0f040404	/* addrmap6 */
		0x00000f0f	/* addrmap7 */
		0x00001919	/* addrmap8 */
	>;

	microchip,phy-reg = <
		0x0000040c	/* dcr */
		0x0064401b	/* dsgcr */
		0x8000b0cf	/* dtcr0 */
		0x00010237	/* dtcr1 */
		0x00c01884	/* dxccr */
		0x00000dac	/* pgcr2 */
		0x00000000	/* schcr1 */
		0x00079b09	/* zq0pr */
		0x00079b2b	/* zq1pr */
		0x00079b2b	/* zq2pr */
		0x03058f00	/* zqcr */
	>;

	microchip,phy_timing-reg = <
		0x06210f08	/* dtpr0 */
		0x28150018	/* dtpr1 */
		0x0005010e	/* dtpr2 */
		0x03000101	/* dtpr3 */
		0x01040806	/* dtpr4 */
		0x00300f08	/* dtpr5 */
		0x3e81f410	/* ptr0 */
		0x61a81194	/* ptr1 */
		0x00083def	/* ptr2 */
		0x10e7a000	/* ptr3 */
		0x10030800	/* ptr4 */
	>;

};
