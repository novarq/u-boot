## arch/arm/mach-microchipsw/Kconfig
```kconfig
if ARCH_MICROCHIPSW

config SYS_SOC
	default "microchipsw"

config SYS_VENDOR
	default "microchip"

choice
	prompt "Microchip switch SoC select"

config TARGET_LAN969X
	bool "Microchip LAN969x SoC"
	select ARM64
	select ARCH_SUPPORT_TFABOOT
	select DM_SERIAL
	select DM_GPIO
	help
	  Support for Microchip LAN969X reference board platform.

endchoice

config SYS_BOARD
	string "Board name"
	default "lan969x" if TARGET_LAN969X
	default ""

config SYS_CONFIG_NAME
	default "lan969x" if TARGET_LAN969X

endif
```

## configs/microchip_ev23x71a_defconfig
```kconfig
CONFIG_ARM=y
CONFIG_POSITION_INDEPENDENT=y
# CONFIG_ARM64_SUPPORT_AARCH32 is not set
CONFIG_ARCH_MICROCHIPSW=y
CONFIG_TFABOOT=y
CONFIG_ENV_SOURCE_FILE="lan969x"
CONFIG_NR_DRAM_BANKS=3
CONFIG_ENV_OFFSET=0x0
CONFIG_DEFAULT_DEVICE_TREE="lan9696-ev23x71a"
CONFIG_SYS_BOOTM_LEN=0x4000000
CONFIG_SYS_LOAD_ADDR=0x64000000
CONFIG_DEBUG_UART_BASE=0xe0040200
CONFIG_DEBUG_UART_CLOCK=250000000
CONFIG_DEBUG_UART=y
# CONFIG_EFI_LOADER is not set
CONFIG_FIT=y
CONFIG_FIT_VERBOSE=y
# CONFIG_LEGACY_IMAGE_FORMAT is not set
CONFIG_HUSH_PARSER=y
# CONFIG_HUSH_OLD_PARSER is not set
CONFIG_HUSH_MODERN_PARSER=y
CONFIG_CMD_CLK=y
CONFIG_CMD_GPIO=y
CONFIG_CMD_MMC=y
CONFIG_CMD_MTD=y
CONFIG_CMD_PART=y
CONFIG_CMD_USB=y
CONFIG_CMD_WDT=y
CONFIG_CMD_DHCP=y
CONFIG_CMD_DNS=y
CONFIG_CMD_MII=y
CONFIG_CMD_PING=y
CONFIG_CMD_WGET=y
CONFIG_EFI_PARTITION=y
CONFIG_DEVICE_TREE_INCLUDES="lan969x-u-boot.dtsi"
CONFIG_ENV_IS_IN_MMC=y
CONFIG_ENV_MMC_USE_SW_PARTITION=y
CONFIG_ENV_MMC_SW_PARTITION="Env"
CONFIG_PROT_TCP_SACK=y
CONFIG_NET_RANDOM_ETHADDR=y
CONFIG_CLK=y
CONFIG_CLK_LAN966X=y
# CONFIG_I2C is not set
# CONFIG_INPUT is not set
CONFIG_LED=y
CONFIG_LED_GPIO=y
CONFIG_MISC=y
CONFIG_MICROCHIP_FLEXCOM=y
CONFIG_MMC_SDHCI=y
CONFIG_MMC_SDHCI_ATMEL=y
CONFIG_MTD=y
CONFIG_DM_MTD=y
CONFIG_DM_SPI_FLASH=y
CONFIG_SPI_FLASH_SFDP_SUPPORT=y
CONFIG_SPI_FLASH_SST=y
CONFIG_SPI_FLASH_MTD=y
CONFIG_PHY_MICROCHIP=y
CONFIG_DM_MDIO=y
CONFIG_PHY_GIGE=y
CONFIG_MSCC_LAN969X_SWITCH=y
CONFIG_MDIO_MSCC_MIIM=y
CONFIG_PINCTRL=y
CONFIG_PINCTRL_LAN969X=y
CONFIG_SERIAL_SEARCH_ALL=y
CONFIG_DEBUG_UART_ANNOUNCE=y
CONFIG_DEBUG_UART_SKIP_INIT=y
CONFIG_ATMEL_USART=y
CONFIG_SPI=y
CONFIG_DM_SPI=y
CONFIG_ATMEL_QSPI=y
CONFIG_SYSRESET=y
CONFIG_SYSRESET_GPIO=y
CONFIG_USB=y
CONFIG_USB_XHCI_HCD=y
CONFIG_USB_DWC3=y
CONFIG_USB_DWC3_GENERIC=y
CONFIG_DESIGNWARE_WATCHDOG=y
CONFIG_WDT=y
```

## drivers/clk/microchip/Kconfig
```kconfig
config CLK_LAN966X
	bool "Microchip LAN966X and LAN969X clock support"
	depends on ARCH_MICROCHIPSW
	depends on CLK
	help
	  Clock driver for Microchip LAN969X platforms.

config CLK_MPFS
	bool "Clock support for Microchip PolarFire SoC"
	depends on CLK && CLK_CCF
	depends on SYSCON
	depends on REGMAP
	help
	  This enables support clock driver for Microchip PolarFire SoC platform.
```
