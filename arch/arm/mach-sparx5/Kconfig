## arch/arm/mach-sparx5/Kconfig
```kconfig
config SYS_SDRAM_SIZE
        hex "Size of SDRAM"
	default 0x80000000

config TARGET_SPARX5_REAL
	bool "Sparx5 raw metal"
	default y
```

## board/microchip/lan966x/Kconfig
```kconfig
if TARGET_LAN966X

config SYS_BOARD
	default "lan966x"

config SYS_VENDOR
	default "microchip"

config SYS_SOC
	default "lan966x"

config SYS_CONFIG_NAME
	default "lan966x"

choice
	prompt "Choose lan966x target"
	default TARGET_LAN966X_EVB
	help
	  Select the board type.

config TARGET_LAN966X_EVB
	bool "Select EVB board"

config TARGET_LAN966X_SVB
	bool "Select SVB board"

endchoice

endif
```

## board/microchip/lan969x/Kconfig
```kconfig
if TARGET_LAN969X

config SYS_BOARD
	default "lan969x"

config SYS_VENDOR
	default "microchip"

config SYS_SOC
	default "lan969x"

config SYS_CONFIG_NAME
	default "lan969x"

config TARGET_LAN969X_SRAM
	bool "Enable lan969x target for running in SRAM only"
	default n
	help
	  Enable u-boot to run only in SRAM

endif
```

## board/mscc/sparx5/Kconfig
```kconfig
if TARGET_SPARX5

config SYS_BOARD
	default "sparx5"

config SYS_VENDOR
	default "mscc"

config SYS_SOC
	default "sparx5"

config SYS_CONFIG_NAME
	default "sparx5"

config SYS_TEXT_BASE
	default 0x35000000

endif
```

## configs/mchp_lan966x_evb_defconfig
```kconfig
CONFIG_ARM=y
CONFIG_SKIP_LOWLEVEL_INIT=y
CONFIG_SYS_ARCH_TIMER=y
CONFIG_ARM_SMCCC=y
CONFIG_TARGET_LAN966X=y
CONFIG_TEXT_BASE=0x60200000
CONFIG_ENV_SIZE=0x40000
CONFIG_ENV_OFFSET=0x180000
CONFIG_ENV_SECT_SIZE=0x10000
CONFIG_DM_GPIO=y
CONFIG_DEFAULT_DEVICE_TREE="lan966x_pcb8291"
CONFIG_SYS_PROMPT="m => "
CONFIG_DEBUG_UART_BASE=0xe0064200
CONFIG_DEBUG_UART_CLOCK=200000000
CONFIG_DEBUG_UART_BOARD_INIT=y
CONFIG_ENV_OFFSET_REDUND=0x1c0000
CONFIG_SYS_LOAD_ADDR=0x60200000
CONFIG_DEBUG_UART=y
CONFIG_SYS_MEMTEST_START=0x200000
CONFIG_SYS_MEMTEST_END=0x9ff00000
# CONFIG_SYS_MALLOC_CLEAR_ON_INIT is not set
CONFIG_SYS_MONITOR_LEN=524288
CONFIG_FIT=y
CONFIG_QSPI_BOOT=y
CONFIG_SD_BOOT=y
CONFIG_BOOTDELAY=3
CONFIG_USE_BOOTARGS=y
CONFIG_BOOTARGS="console=ttyS0,115200 root=/dev/ram0 loglevel=4 uio_pdrv_genirq.of_id=generic-uio"
CONFIG_LOGLEVEL=7
CONFIG_CONSOLE_MUX=y
# CONFIG_DISPLAY_BOARDINFO is not set
CONFIG_HUSH_PARSER=y
CONFIG_CMD_BOOTZ=y
CONFIG_SYS_BOOTM_LEN=0x2000000
CONFIG_LOOPW=y
CONFIG_CMD_MEMTEST=y
CONFIG_SYS_ALT_MEMTEST=y
CONFIG_CMD_UNZIP=y
CONFIG_CMD_GPT=y
CONFIG_CMD_GPT_RENAME=y
# CONFIG_CMD_LOADS is not set
CONFIG_CMD_MMC=y
CONFIG_CMD_MTD=y
# CONFIG_CMD_PINMUX is not set
CONFIG_CMD_DHCP=y
CONFIG_CMD_MII=y
CONFIG_CMD_PING=y
CONFIG_CMD_EXT4=y
CONFIG_CMD_FAT=y
CONFIG_CMD_MTDPARTS=y
CONFIG_MTDIDS_DEFAULT="nor0=spi0"
CONFIG_OF_LIST="lan966x_pcb8291 lan966x_pcb8290 lan966x_pcb8281 lan966x_pcb8385"
CONFIG_DTB_RESELECT=y
CONFIG_MULTI_DTB_FIT=y
CONFIG_ENV_SOURCE_FILE="lan966x"
CONFIG_ENV_IS_IN_FAT=y
CONFIG_ENV_IS_IN_MMC=y
CONFIG_ENV_IS_IN_SPI_FLASH=y
CONFIG_SYS_REDUNDAND_ENVIRONMENT=y
CONFIG_ENV_FAT_DEVICE_AND_PART="0:1"
CONFIG_VERSION_VARIABLE=y
CONFIG_NET_RANDOM_ETHADDR=y
CONFIG_REGMAP=y
# CONFIG_OF_TRANSLATE is not set
CONFIG_CLK=y
CONFIG_MISC=y
CONFIG_MMC_SDHCI=y
CONFIG_MMC_SDHCI_SDMA=y
CONFIG_MMC_SDHCI_ATMEL=y
CONFIG_MTD=y
CONFIG_DM_MTD=y
CONFIG_DM_SPI_FLASH=y
CONFIG_SF_DEFAULT_SPEED=20000000
CONFIG_SPI_FLASH_ATMEL=y
CONFIG_SPI_FLASH_MACRONIX=y
CONFIG_SPI_FLASH_SST=y
CONFIG_SPI_FLASH_MTD=y
CONFIG_PHY_MICROCHIP=y
CONFIG_MSCC_LAN966X_SWITCH=y
CONFIG_PINCTRL=y
CONFIG_PINCONF=y
CONFIG_PINCTRL_LAN966X=y
CONFIG_DEBUG_UART_SKIP_INIT=y
CONFIG_ATMEL_USART=y
CONFIG_LAN966X_SERIAL=y
CONFIG_SPI=y
CONFIG_DM_SPI=y
CONFIG_ATMEL_QSPI=y
CONFIG_OF_LIBFDT_OVERLAY=y
```

## configs/mchp_lan969x_sr_defconfig
```kconfig
CONFIG_ARM=y
# CONFIG_ARM64_SUPPORT_AARCH32 is not set
CONFIG_TARGET_LAN969X=y
CONFIG_TEXT_BASE=0x00000000
CONFIG_NR_DRAM_BANKS=1
CONFIG_ENV_OFFSET=0x100000
CONFIG_ENV_SECT_SIZE=0x1000
CONFIG_DM_GPIO=y
CONFIG_DEFAULT_DEVICE_TREE="lan969x_sr"
CONFIG_SYS_PROMPT="m => "
CONFIG_IDENT_STRING="lan969x"
CONFIG_SYS_LOAD_ADDR=0x60000000
CONFIG_FIT=y
CONFIG_OF_BOARD_SETUP=y
CONFIG_QSPI_BOOT=y
CONFIG_SD_BOOT=y
CONFIG_BOOTDELAY=3
CONFIG_USE_BOOTARGS=y
CONFIG_BOOTARGS="console=ttyS0,115200 root=/dev/ram0 loglevel=7"
CONFIG_LOGLEVEL=2
CONFIG_CONSOLE_MUX=y
# CONFIG_DISPLAY_BOARDINFO is not set
CONFIG_BOARD_LATE_INIT=y
CONFIG_HUSH_PARSER=y
CONFIG_CMD_GREPENV=y
CONFIG_CMD_ENV_CALLBACK=y
CONFIG_CMD_ENV_FLAGS=y
CONFIG_CMD_MD5SUM=y
CONFIG_CMD_MEMINFO=y
CONFIG_CMD_MEMTEST=y
CONFIG_SYS_ALT_MEMTEST=y
CONFIG_CMD_GPIO=y
CONFIG_CMD_GPT=y
CONFIG_CMD_GPT_RENAME=y
CONFIG_CMD_MMC=y
CONFIG_CMD_PART=y
CONFIG_CMD_SF_TEST=y
CONFIG_CMD_SPI=y
CONFIG_CMD_DHCP=y
CONFIG_CMD_PING=y
CONFIG_CMD_TIME=y
CONFIG_CMD_EXT2=y
CONFIG_CMD_EXT4=y
CONFIG_CMD_FAT=y
CONFIG_ENV_SOURCE_FILE="lan969x"
CONFIG_ENV_IS_IN_FAT=y
CONFIG_ENV_IS_IN_MMC=y
CONFIG_ENV_IS_IN_SPI_FLASH=y
CONFIG_ENV_FAT_DEVICE_AND_PART="0:1"
CONFIG_CLK=y
CONFIG_CLK_CCF=y
CONFIG_CLK_AT91=y
CONFIG_AT91_GENERIC_CLK=y
CONFIG_MMC_SDHCI=y
CONFIG_MMC_SDHCI_SDMA=y
CONFIG_MMC_SDHCI_ATMEL=y
CONFIG_DM_SPI_FLASH=y
CONFIG_SF_DEFAULT_SPEED=10000000
CONFIG_SPI_FLASH_ATMEL=y
CONFIG_SPI_FLASH_SST=y
CONFIG_PINCTRL=y
CONFIG_PINCTRL_LAN969X=y
CONFIG_ATMEL_USART=y
CONFIG_SPI=y
CONFIG_DM_SPI=y
```
